## main/Kconfig.projbuild
```kconfig
menu "Application Configuration"

	menu "WiFi Configuration"

		config ESP_WIFI_SSID
			string "WiFi SSID"
			default "myssid"
			help
				SSID (network name) to connect to.

		config ESP_WIFI_PASSWORD
			string "WiFi Password"
			default "mypassword"
			help
				WiFi password (WPA or WPA2) to use.

		config ESP_MAXIMUM_RETRY
			int "Maximum retry"
			default 5
			help
				Set the Maximum retry to avoid station reconnecting to the AP unlimited when the AP is really inexistent.

	endmenu

	menu "HTTP Server Configuration"

		config HTTP_ENDPOINT
			string "HTTP Endpoint"
			default "httpbin.org"
			help
				Target endpoint host-name for the example to use.

		config HTTP_PORT
			int "HTTP Port"
			default 8080
			help
				Target endpoint port-number for the example to use.

		config HTTP_AUTH_BASIC
			bool "Enable BASIC authentication"
			default false
			help
				Enable BASIC authentication.

			
		config HTTP_USER
			depends on HTTP_AUTH_BASIC
			string "HTTP Username"
			default "user"
			help
				Target endpoint user-name for the example to use.

		config HTTP_PASSWORD
			depends on HTTP_AUTH_BASIC
			string "HTTP Password"
			default "password"
			help
				Target endpoint user-password for the example to use.

	endmenu

endmenu
```

## sdkconfig.defaults
```kconfig
#
# Partition Table
#
CONFIG_PARTITION_TABLE_CUSTOM=y
CONFIG_PARTITION_TABLE_CUSTOM_FILENAME="partitions_example.csv"
CONFIG_PARTITION_TABLE_FILENAME="partitions_example.csv"

#
# Disable WatchDog
#
CONFIG_ESP_INT_WDT=n
CONFIG_INT_WDT=n
CONFIG_TASK_WDT=n
CONFIG_ESP_TASK_WDT_EN=n
```
